resourcestring                                     {english}

  capFCtime='Time since boot';
  hntFCtime='Time since boot of flight controller (since drone was powerd up)';
  hntClose='Disconnect and quit';
  hntStatusBar='Number messages sent | Number messages received | Status';
  capTime='Time';
  hntTime='Date/time UTC from message SYSTEM_TIME (2)';
  capRecord='Record CSV';
  hntRecord='Record the received data messages to a CSV file in hexa-decimal format';
  capSensor='Create sensor file';
  hntSensor='Save received data messages to a binary file like Sensor files in flight logs';
  capWarning='No warranty. You use this tool on your own risk!';
  hntPowerCycle='Disconnect, switch off camera, wait a moment,'+lineending+'switch on camera and connect.';

  capSaveText='&Save text';
  hntSaveText='Save list of text messages to text file';
  capDeleteText='&Delete text';
  hntDeleteText='Empty the text message list.';
  capPort='Scan USB ports...';
  hntPort='In case of connection Problems unplug and plug USB cable.'+lineending+
          'Double click to update port list.';
  capConnect='Connect';
  hntConnect='Connect to selected USB port';
  capDisConnect='Disconnect';
  hntDisConnect='Disonnect UART from USB port';
  hntSpeed='Select baud rate. Default 115200 shoult work for drone and camera.';
  capClose='Close';
  capCopySerial='Copy Vehicle ID';
  hntCopySerial='Copy Vehicle ID (serial number) to clipboard.';
  capReboot='Reboot';
  hntReboot='Restart gimbal';

  captsGUI='Act as H480 GUI replacement';
  captsYGC='Act as gimbal checker for CGO3+';
  captsFC='Act as flight controller to CGO3+ (Demo)';
  capSensorInfo='Sensor information';
  capGPSinfo='GNSS information';
  capSettings='System / Settings';
  msgPropellerRemoved='I have removed all propellers.';
  capEnableTesting='&Enable testing';
  hntEnableTesting='Test motors only without propellers!';
  capLimitMsg='Limit text messages to 600';
  capHighRPM='High RPM';
  hntHighRPM='Set propeller speed to 100. Handle with care';
  hntGeoFence='Maximum distance from home point in Smart Mode.';
  hntHeightLimit='Maximum elevation above home point in Smart and Angle mode.';
  capGimbalCali='Gimbal calibration';
  hntGimbalCali='Gimbal calibration process like ST16 initiated.'+lineending+
                'Power cycle the camera once the calibration is finished.';
  capSystemTime='System time UTC';
  capNotUsed='Not used';
  hntNotUsed='Satellits not (yet) used for calculation of position';
  capSatUsed='Used for calculation';
  hntSatUsed='Satellits used for calculation of position';
  hntBoottime='Time since boot of the device';
  capVersion='SW versions';
  hntVersion='Read different software version from gimbal firmware';
  capYGC_Type='Show 2nd message';
  hntYGC_Type='Select which message you want to see in the second table.'+lineending+
              'Channel data will be empty in most cases. This is a special message.';
  hntPanelRight='Do gimbal calibration. Check manual. Process going from above to bottom.';
  capSerialNo='Serial number:';
  capCenter='Center';
  hntCenter='Set to neutral position';
  hntTiltControl='Camera tilt';
  hntTiltMode='Tilt mode: Angle / Velocity';
  hntPanMode='Pan mode: Follow / Pan controllable / Global / Angle';
  hntPanControl='Pan control';
  capAddValue='Additonal data chart';
  hntAddValue='Select what you want to see in the chart';
  titSaveText='Save text messages...';

  rsSaved=' saved';
  rsDisconnected='Disconnected';
  rsConnected='Connected';
  rsEnabled='Enabled';
  rsAvailable='Available';
  rsNotMounted='Not mounted';
  rsInUse='satellites in use';
  rsVisible='satellites visible';
  rsConfirm='Please confirm';
  rsTime='Time';
  rsTimeUTC='System time UTC';
  rsSelected='selected';
  rsMotor='Motor';
  rsACW=' (A-CW)';
  rsBCCW=' (B-CCW)';
  rsFixType='Fix type';
  rsValue='Value';

  errSensorsNotHealthy='Sensors not healthy!';
  errNoUSBport='No USB port available';

   hntTempCali='This needs a special procedure. Do this only if you exactly know what you are doing!';


