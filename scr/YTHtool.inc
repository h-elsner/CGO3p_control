resourcestring                                     {english}

  capFCtime='Time since boot';
  hntFCtime='Time since boot of flight controller (since drone was powerd up)';
  hntClose='Disconnect and quit';
  hntStatusBar='Number messages sent | Number messages received | Status';
  capTime='Time';
  hntTime='Date/time UTC from message SYSTEM_TIME (2)';
  capSatSNR='Signal to noise ratio';
  hntSatSNR='Signal to noise ratio of satellites  [dB]';
  capPolar='Azimuth and elevation of visible sats';
  hntPolar='Azimuth: Direction of satellite 0 to 360°, Elevation: 0 to 90° (0°: right on top of receiver, 90°: on the horizon)';
  capRecord='Record CSV';
  hntRecord='Record the received data messages to a CSV file in hexa-decimal format';
  capSensor='Create sensor file';
  hntSensor='Save received data messages to a binary file like Sensor files in flight logs';
  capSaveProt='&Save text';
  hntSaveProt='Save list of text messages to text file';
  hntPort='In case of connection Problems unplug and plug USB cable.'+lineending+'Double click to update port list.';
  capConnect='Connect';
  hntConnect='Connect to selected USB port';
  capDisConnect='Disconnect';
  hntDisConnect='Disonnect UART from USB port';
  hntSpeed='Select baud rate. Default 115200 shoult work for drone and camera.';

  hntGeoFence='Maximum distance from home point in Smart Mode.';
  hntHeightLimit='Maximum elevation above home point in Smart and Angle mode.';
  hntGimbalCali='Gimbal calibration process like ST16 initiated.'+lineending+'Power cycle the camera once the calibration is finished.';

  msgPropellerRemoved='I have removed all propellers.';
  hntEnableTesting='Test motors only without propellers!';

  rsSaved=' saved';
  rsDisconnected='Disconnected';
  rsConnected='Connected';
  rsEnabled='Enabled';
  rsAvailable='Available';
  rsNotMounted='Not mounted';
  rsInUse='satellites in use';
  rsVisible='satellites visible';
  rsConfirm='Please confirm';
  rsTime='Time';
  rsTimeUTC='System time UTC';
  rsSelected='selected';
  rsMotor='Motor';
  rsACW=' (A-CW)';
  rsBCCW=' (B-CCW)';
  rsFixType='Fix type';

  errSensorsNotHealthy='Sensors not healthy!';
  errNoUSBport='No USB port available';

  linkLazarus='https://www.lazarus-ide.org/';

