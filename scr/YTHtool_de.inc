resourcestring                                     {deutsch}

  capFCtime='Zeit seit Boot';
  hntFCtime='Zeit seit Boot vom Flight Controller (also seit der Kopter eingeschaltet worden war)';
  hntClose='Verbindung trennen und beenden';
  hntStatusBar='Anzahl gesendeter Messages | Anzahl empfangener Messages received | Status';
  capTime='Zeit';
  hntTime='Datum/Zeit UTC aus Message SYSTEM_TIME (2)';
  capSatSNR='Signal-Rauschabstand';
  hntSatSNR='Signal-Rauschabstand der Satelliten  [dB]';
  capPolar='Azimu und Höhenwinkel der Satelliten';
  hntPolar='Azimut: Richtung der Satelliten von 0 bis 360°, Höhenwinkel: 0 bis 90° (0°: senkrecht über dem Empfänger, 90°: am Horizont)';
  capRecord='CSV aufzeichnen';
  hntRecord='Aufzeichnen der empfangenen Daten-Messages in eine CSV Datei als Hexadezimal Zahlen';
  capSensor='Sensordatei erzeugen';
  hntSensor='Daten-Messages in eine binäre Datei speichern. Das Format ist wie die Sensordateien im FlightLog';
  capSaveProt='&Text speichern';
  hntSaveProt='Die Textmessages in eine Textdatei speichern';
  hntPort='Im Falle von Verbindungsproblemen USB-Kabel ziehen und Stecken.'+lineending+
          'Doppelklick um Portliste zu erneuern.';
  capConnect='Verbinden';
  hntConnect='Mit dem ausgewählten USB-Port verbinden';
  capDisConnect='Trennen';
  hntDisConnect='System vom USB-Port trennen';
  hntSpeed='Baudrate einstellen. Default 115200 sollte für Kopter und Kamera gleichermaßen funktionieren.';
  capClose='Beenden';
  capDeleteGUItext='&Text löschen';
  hntDeleteGUItext='Die Message Liste leeren.';
  capCopySerial='Vehicle ID kopieren';
  hntCopySerial='Vehicle ID (Seriennummer) in die Zwischenablage kopieren.';

  captsGUI='Als H480 GUI Ersatz';
  captsYGC='Als Gimbaltester für CGO3+';
  captsFC='Steuerung als FlightController für CGO3+ (Demo)';
  capSensorInfo='Sensorinformationen';
  capGPSinfo='GNSS Informationen';
  capSettings='System / Einstellungen';
  msgPropellerRemoved='Ich habe alle Propeller entfernt.';
  capEnableTesting='&Freigabe Motortest';
  hntEnableTesting='Motoren immer ohne Propeller testen!';
  capLimitMsg='Begrenze Anzahl der Textmessages auf 600';
  capHighRPM='Hohe RPM';
  hntHighRPM='Propellerdrehzahl auf 100 einstellen. Vorsicht beim Testen!';
  hntGeoFence='Maximale Entfernung vom Startpunkt im Smart Mode.';
  hntHeightLimit='Maximale Höhe über Startpunkt im Smart oder Angle mode.';
  capGimbalCali='Gimbalkalibrierung';
  hntGimbalCali='Gimbalkalibrierungsprozess wie von ST16 gestartet.'+lineending+
                'Kamera aus- und wieder einschalten nachdem die Kalibrierung fertig ist.';
  hntGPS='Global Positioning System, früher NAVSTAR GPS';
  hntGLONASS='Глоба́льная навигацио́нная спу́тниковая систе́ма (ГЛОНА́СС)';
  hntSBAS='Satellite Based Augmentation System'+lineending+
          'Eine Methode, um die Sytemattribute wie Präzision, Zuverlässigkeit und Verfügbarkeit zu verbessern.';
  capSystemTime='Systemzeit UTC';
  capNotUsed='Ungenutzt';
  hntNotUsed='Satelliten, die (noch) nicht für die Positionsbestimmung genutzt sind';
  capSatUsed='Benutzt für Pos';
  hntSatUsed='Satelliten, die für die Positionsbestimmung genutzt werden';
  hntBoottime='Zeit seit Booten des Systems';
  capVersion='SW Versionen';
  hntVersion='Lese die verschiedenen Softwareversionen vom Gimbal aus';
  capYGC_Type='Anzeige einer 2. Message';
  hntYGC_Type='Wähle die Message aus, die du in der 2. Tabelle anzeigen willst.'+lineending+
              'Channel data bleibt in den meisten Fällen leer. Dies ist eine seltene Message.';
  hntPanelRight='Gimbalkalibrierung. Lese dazu unbedingt die Anleitung. Der Prozess geht von oben nach unten.';
  capSerialNo='Seriennummer:';
  capCenter='Mitte';
  hntCenter='Setze zurück in neutrale Position (Mittelstellung)';
  hntTiltControl='Tamera neigen';
  hntTiltMode='Tilt mode: Angle / Velocity';
  hntPanMode='Pan mode: Follow / Pan controllable / Global';
  hntPanControl='Kamera drehen';
  capTelemetry='Testtelemetrie senden';
  hntTelemetry='Telemetrie-Messages über WiFi senden, um Empfang in den Sensor-Dateien im FlightLog zu testen.';
  capAddValue='Zusätzliches Datendiagramm';
  hntAddValue='Wähle, welchen Wert du im Diagramm sehen willst.';
  capScreenshot='Screenshot';
  hntScreenshot='Screenshot zur Dokumentation oder Diskussion im Forum aufnehmen.';
  titScreenshot='Screenshot als Bild speichern...';

  rsSaved=' gespeichert';
  rsDisconnected='Getrennt';
  rsConnected='Verbunden';
  rsEnabled='Enabled';
  rsAvailable='verfügbar';
  rsNotMounted='nicht vorhanden';
  rsInUse='Satelliten in Benutzung';
  rsVisible='Sichtbare Satelliten';
  rsConfirm='Bitte bestätigen';
  rsTime='Zeit';
  rsTimeUTC='System time UTC';
  rsSelected='ausgewählt';
  rsMotor='Motor';
  rsACW=' (A-CW)';
  rsBCCW=' (B-CCW)';
  rsFixType='Fix type';

  errSensorsNotHealthy='Sensoren nicht in Ordnung!';
  errNoUSBport='Kein USB-Port verfügbar';

